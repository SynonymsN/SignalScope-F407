/**
  ******************************************************************************
  * @file    bsp_lcd.c
  * @brief   LCD驱动实现 - 正点原子探索者F407 (FSMC接口)
  * @note    支持 ILI9341/NT35310/ST7789 等常见控制器
  ******************************************************************************
  */

#include "bsp_lcd.h"
#include <stdarg.h>
#include <string.h>

LCD_DevTypeDef lcddev;

/* 8x16 ASCII字库 (简化版，只包含基本字符) */
static const uint8_t ASCII_8x16[][16] = {
    {0x00,0x00,0x00,0x00,0x00,0x00,0x00,0x00,0x00,0x00,0x00,0x00,0x00,0x00,0x00,0x00}, /* ' ' */
    {0x00,0x00,0x18,0x3C,0x3C,0x3C,0x18,0x18,0x18,0x00,0x18,0x18,0x00,0x00,0x00,0x00}, /* '!' */
    {0x00,0x63,0x63,0x63,0x22,0x00,0x00,0x00,0x00,0x00,0x00,0x00,0x00,0x00,0x00,0x00}, /* '"' */
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    {0x00,0x00,0x00,0x00,0x00,0x7F,0x66,0x0C,0x18,0x30,0x63,0x7F,0x00,0x00,0x00,0x00}, /* 'z' */
};

static SRAM_HandleTypeDef g_sram_handle;

/* 调试输出 */
#include <stdio.h>
#include "usart.h"
static void LCD_Debug(const char *fmt, ...)
{
    char buf[128];
    va_list args;
    va_start(args, fmt);
    vsnprintf(buf, sizeof(buf), fmt, args);
    va_end(args);
    HAL_UART_Transmit(&huart1, (uint8_t*)buf, strlen(buf), 100);
}

/* SRAM MSP初始化 - 被HAL_SRAM_Init调用 */
void HAL_SRAM_MspInit(SRAM_HandleTypeDef *hsram)
{
    (void)hsram;
    GPIO_InitTypeDef gpio_init_struct;
    
    __HAL_RCC_FSMC_CLK_ENABLE();
    __HAL_RCC_GPIOD_CLK_ENABLE();
    __HAL_RCC_GPIOE_CLK_ENABLE();
    __HAL_RCC_GPIOF_CLK_ENABLE();
    __HAL_RCC_GPIOG_CLK_ENABLE();
    
    /* PD0,1,8,9,10,14,15 - 数据线D2,D3,D13,D14,D15,D0,D1 */
    gpio_init_struct.Pin = GPIO_PIN_0 | GPIO_PIN_1 | GPIO_PIN_8 | GPIO_PIN_9 | 
                           GPIO_PIN_10 | GPIO_PIN_14 | GPIO_PIN_15;
    gpio_init_struct.Mode = GPIO_MODE_AF_PP;
    gpio_init_struct.Pull = GPIO_PULLUP;
    gpio_init_struct.Speed = GPIO_SPEED_FREQ_HIGH;
    gpio_init_struct.Alternate = GPIO_AF12_FSMC;
    HAL_GPIO_Init(GPIOD, &gpio_init_struct);
    
    /* PD4 - RD (NOE), PD5 - WR (NWE) */
    gpio_init_struct.Pin = GPIO_PIN_4 | GPIO_PIN_5;
    HAL_GPIO_Init(GPIOD, &gpio_init_struct);
    
    /* PE7-15 - 数据线D4-D12 */
    gpio_init_struct.Pin = GPIO_PIN_7 | GPIO_PIN_8 | GPIO_PIN_9 | GPIO_PIN_10 |
                           GPIO_PIN_11 | GPIO_PIN_12 | GPIO_PIN_13 | GPIO_PIN_14 | GPIO_PIN_15;
    HAL_GPIO_Init(GPIOE, &gpio_init_struct);
    
    /* PF12: A6 (RS信号) */
    gpio_init_struct.Pin = GPIO_PIN_12;
    HAL_GPIO_Init(GPIOF, &gpio_init_struct);
    
    /* PG12: NE4 (片选) */
    gpio_init_struct.Pin = GPIO_PIN_12;
    HAL_GPIO_Init(GPIOG, &gpio_init_struct);
}

/* ILI9341初始化序列 */
static void lcd_ex_ili9341_reginit(void)
{
    LCD->LCD_REG = 0xCF;
    LCD->LCD_RAM = 0x00; LCD->LCD_RAM = 0xC1; LCD->LCD_RAM = 0x30;
    LCD->LCD_REG = 0xED;
    LCD->LCD_RAM = 0x64; LCD->LCD_RAM = 0x03; LCD->LCD_RAM = 0x12; LCD->LCD_RAM = 0x81;
    LCD->LCD_REG = 0xE8;
    LCD->LCD_RAM = 0x85; LCD->LCD_RAM = 0x10; LCD->LCD_RAM = 0x7A;
    LCD->LCD_REG = 0xCB;
    LCD->LCD_RAM = 0x39; LCD->LCD_RAM = 0x2C; LCD->LCD_RAM = 0x00; 
    LCD->LCD_RAM = 0x34; LCD->LCD_RAM = 0x02;
    LCD->LCD_REG = 0xF7;
    LCD->LCD_RAM = 0x20;
    LCD->LCD_REG = 0xEA;
    LCD->LCD_RAM = 0x00; LCD->LCD_RAM = 0x00;
    LCD->LCD_REG = 0xC0;
    LCD->LCD_RAM = 0x1B;
    LCD->LCD_REG = 0xC1;
    LCD->LCD_RAM = 0x01;
    LCD->LCD_REG = 0xC5;
    LCD->LCD_RAM = 0x30; LCD->LCD_RAM = 0x30;
    LCD->LCD_REG = 0xC7;
    LCD->LCD_RAM = 0xB7;
    LCD->LCD_REG = 0x36;
    LCD->LCD_RAM = 0x48;
    LCD->LCD_REG = 0x3A;
    LCD->LCD_RAM = 0x55;
    LCD->LCD_REG = 0xB1;
    LCD->LCD_RAM = 0x00; LCD->LCD_RAM = 0x1A;
    LCD->LCD_REG = 0xB6;
    LCD->LCD_RAM = 0x0A; LCD->LCD_RAM = 0xA2;
    LCD->LCD_REG = 0xF2;
    LCD->LCD_RAM = 0x00;
    LCD->LCD_REG = 0x26;
    LCD->LCD_RAM = 0x01;
    LCD->LCD_REG = 0xE0;
    LCD->LCD_RAM = 0x0F; LCD->LCD_RAM = 0x2A; LCD->LCD_RAM = 0x28; LCD->LCD_RAM = 0x08;
    LCD->LCD_RAM = 0x0E; LCD->LCD_RAM = 0x08; LCD->LCD_RAM = 0x54; LCD->LCD_RAM = 0xA9;
    LCD->LCD_RAM = 0x43; LCD->LCD_RAM = 0x0A; LCD->LCD_RAM = 0x0F; LCD->LCD_RAM = 0x00;
    LCD->LCD_RAM = 0x00; LCD->LCD_RAM = 0x00; LCD->LCD_RAM = 0x00;
    LCD->LCD_REG = 0xE1;
    LCD->LCD_RAM = 0x00; LCD->LCD_RAM = 0x15; LCD->LCD_RAM = 0x17; LCD->LCD_RAM = 0x07;
    LCD->LCD_RAM = 0x11; LCD->LCD_RAM = 0x06; LCD->LCD_RAM = 0x2B; LCD->LCD_RAM = 0x56;
    LCD->LCD_RAM = 0x3C; LCD->LCD_RAM = 0x05; LCD->LCD_RAM = 0x10; LCD->LCD_RAM = 0x0F;
    LCD->LCD_RAM = 0x3F; LCD->LCD_RAM = 0x3F; LCD->LCD_RAM = 0x0F;
    LCD->LCD_REG = 0x2B;
    LCD->LCD_RAM = 0x00; LCD->LCD_RAM = 0x00; LCD->LCD_RAM = 0x01; LCD->LCD_RAM = 0x3F;
    LCD->LCD_REG = 0x2A;
    LCD->LCD_RAM = 0x00; LCD->LCD_RAM = 0x00; LCD->LCD_RAM = 0x00; LCD->LCD_RAM = 0xEF;
    LCD->LCD_REG = 0x11;
    HAL_Delay(120);
    LCD->LCD_REG = 0x29;
}

/* ST7789初始化序列 */
static void lcd_ex_st7789_reginit(void)
{
    LCD->LCD_REG = 0x11;
    HAL_Delay(120);
    LCD->LCD_REG = 0x36;
    LCD->LCD_RAM = 0x00;
    LCD->LCD_REG = 0x3A;
    LCD->LCD_RAM = 0x05;
    LCD->LCD_REG = 0xB2;
    LCD->LCD_RAM = 0x0C; LCD->LCD_RAM = 0x0C; LCD->LCD_RAM = 0x00; 
    LCD->LCD_RAM = 0x33; LCD->LCD_RAM = 0x33;
    LCD->LCD_REG = 0xB7;
    LCD->LCD_RAM = 0x35;
    LCD->LCD_REG = 0xBB;
    LCD->LCD_RAM = 0x32;
    LCD->LCD_REG = 0xC0;
    LCD->LCD_RAM = 0x0C;
    LCD->LCD_REG = 0xC2;
    LCD->LCD_RAM = 0x01;
    LCD->LCD_REG = 0xC3;
    LCD->LCD_RAM = 0x10;
    LCD->LCD_REG = 0xC4;
    LCD->LCD_RAM = 0x20;
    LCD->LCD_REG = 0xC6;
    LCD->LCD_RAM = 0x0F;
    LCD->LCD_REG = 0xD0;
    LCD->LCD_RAM = 0xA4; LCD->LCD_RAM = 0xA1;
    LCD->LCD_REG = 0xE0;
    LCD->LCD_RAM = 0xD0; LCD->LCD_RAM = 0x00; LCD->LCD_RAM = 0x02; LCD->LCD_RAM = 0x07;
    LCD->LCD_RAM = 0x0A; LCD->LCD_RAM = 0x28; LCD->LCD_RAM = 0x32; LCD->LCD_RAM = 0x44;
    LCD->LCD_RAM = 0x42; LCD->LCD_RAM = 0x06; LCD->LCD_RAM = 0x0E; LCD->LCD_RAM = 0x12;
    LCD->LCD_RAM = 0x14; LCD->LCD_RAM = 0x17;
    LCD->LCD_REG = 0xE1;
    LCD->LCD_RAM = 0xD0; LCD->LCD_RAM = 0x00; LCD->LCD_RAM = 0x02; LCD->LCD_RAM = 0x07;
    LCD->LCD_RAM = 0x0A; LCD->LCD_RAM = 0x28; LCD->LCD_RAM = 0x31; LCD->LCD_RAM = 0x54;
    LCD->LCD_RAM = 0x47; LCD->LCD_RAM = 0x0E; LCD->LCD_RAM = 0x1C; LCD->LCD_RAM = 0x17;
    LCD->LCD_RAM = 0x1B; LCD->LCD_RAM = 0x1E;
    LCD->LCD_REG = 0x2A;
    LCD->LCD_RAM = 0x00; LCD->LCD_RAM = 0x00; LCD->LCD_RAM = 0x00; LCD->LCD_RAM = 0xEF;
    LCD->LCD_REG = 0x2B;
    LCD->LCD_RAM = 0x00; LCD->LCD_RAM = 0x00; LCD->LCD_RAM = 0x01; LCD->LCD_RAM = 0x3F;
    LCD->LCD_REG = 0x29;
}

/* NT35310初始化序列 */
static void lcd_ex_nt35310_reginit(void)
{
    LCD->LCD_REG = 0xED;
    LCD->LCD_RAM = 0x01; LCD->LCD_RAM = 0xFE;
    LCD->LCD_REG = 0xEE;
    LCD->LCD_RAM = 0xDE; LCD->LCD_RAM = 0x21;
    LCD->LCD_REG = 0xF1;
    LCD->LCD_RAM = 0x01;
    LCD->LCD_REG = 0xDF;
    LCD->LCD_RAM = 0x10;
    LCD->LCD_REG = 0xC4;
    LCD->LCD_RAM = 0x8F;
    LCD->LCD_REG = 0x36;
    LCD->LCD_RAM = 0x00;
    LCD->LCD_REG = 0x3A;
    LCD->LCD_RAM = 0x55;
    LCD->LCD_REG = 0x11;
    HAL_Delay(120);
    LCD->LCD_REG = 0x29;
}

/* ILI9806初始化序列 (480x800) */
static void lcd_ex_ili9806_reginit(void)
{
    LCD->LCD_REG = 0xFF;
    LCD->LCD_RAM = 0xFF; LCD->LCD_RAM = 0x98; LCD->LCD_RAM = 0x06;

    LCD->LCD_REG = 0xBC;
    LCD->LCD_RAM = 0x01; LCD->LCD_RAM = 0x0F; LCD->LCD_RAM = 0x61;
    LCD->LCD_RAM = 0xFF; LCD->LCD_RAM = 0x01; LCD->LCD_RAM = 0x01;
    LCD->LCD_RAM = 0x0B; LCD->LCD_RAM = 0x10; LCD->LCD_RAM = 0x37;
    LCD->LCD_RAM = 0x63; LCD->LCD_RAM = 0xFF; LCD->LCD_RAM = 0xFF;
    LCD->LCD_RAM = 0x01; LCD->LCD_RAM = 0x01; LCD->LCD_RAM = 0x00;
    LCD->LCD_RAM = 0x00; LCD->LCD_RAM = 0xFF; LCD->LCD_RAM = 0x52;
    LCD->LCD_RAM = 0x01; LCD->LCD_RAM = 0x00; LCD->LCD_RAM = 0x40;

    LCD->LCD_REG = 0xBD;
    LCD->LCD_RAM = 0x01; LCD->LCD_RAM = 0x23; LCD->LCD_RAM = 0x45;
    LCD->LCD_RAM = 0x67; LCD->LCD_RAM = 0x01; LCD->LCD_RAM = 0x23;
    LCD->LCD_RAM = 0x45; LCD->LCD_RAM = 0x67;

    LCD->LCD_REG = 0xBE;
    LCD->LCD_RAM = 0x00; LCD->LCD_RAM = 0x01; LCD->LCD_RAM = 0xAB;
    LCD->LCD_RAM = 0x60; LCD->LCD_RAM = 0x22; LCD->LCD_RAM = 0x22;
    LCD->LCD_RAM = 0x22; LCD->LCD_RAM = 0x22; LCD->LCD_RAM = 0x22;

    LCD->LCD_REG = 0xC7; LCD->LCD_RAM = 0x36;

    LCD->LCD_REG = 0xED;
    LCD->LCD_RAM = 0x7F; LCD->LCD_RAM = 0x0F;

    LCD->LCD_REG = 0xC0;
    LCD->LCD_RAM = 0x0F; LCD->LCD_RAM = 0x0B; LCD->LCD_RAM = 0x0A;

    LCD->LCD_REG = 0xFC; LCD->LCD_RAM = 0x08;

    LCD->LCD_REG = 0xDF;
    LCD->LCD_RAM = 0x00; LCD->LCD_RAM = 0x00; LCD->LCD_RAM = 0x00;
    LCD->LCD_RAM = 0x00; LCD->LCD_RAM = 0x00; LCD->LCD_RAM = 0x20;

    LCD->LCD_REG = 0xF3; LCD->LCD_RAM = 0x74;

    LCD->LCD_REG = 0xB4;
    LCD->LCD_RAM = 0x00; LCD->LCD_RAM = 0x00; LCD->LCD_RAM = 0x00;

    LCD->LCD_REG = 0xF7; LCD->LCD_RAM = 0x82;

    LCD->LCD_REG = 0xB1;
    LCD->LCD_RAM = 0x00; LCD->LCD_RAM = 0x13; LCD->LCD_RAM = 0x13;

    LCD->LCD_REG = 0xF2;
    LCD->LCD_RAM = 0x80; LCD->LCD_RAM = 0x04; LCD->LCD_RAM = 0x40; LCD->LCD_RAM = 0x28;

    LCD->LCD_REG = 0xC1;
    LCD->LCD_RAM = 0x17; LCD->LCD_RAM = 0x88; LCD->LCD_RAM = 0x88; LCD->LCD_RAM = 0x20;

    LCD->LCD_REG = 0xE0;
    LCD->LCD_RAM = 0x00; LCD->LCD_RAM = 0x0A; LCD->LCD_RAM = 0x12;
    LCD->LCD_RAM = 0x10; LCD->LCD_RAM = 0x0E; LCD->LCD_RAM = 0x20;
    LCD->LCD_RAM = 0xCC; LCD->LCD_RAM = 0x07; LCD->LCD_RAM = 0x06;
    LCD->LCD_RAM = 0x0B; LCD->LCD_RAM = 0x0E; LCD->LCD_RAM = 0x0F;
    LCD->LCD_RAM = 0x0D; LCD->LCD_RAM = 0x15; LCD->LCD_RAM = 0x10;
    LCD->LCD_RAM = 0x00;

    LCD->LCD_REG = 0xE1;
    LCD->LCD_RAM = 0x00; LCD->LCD_RAM = 0x0B; LCD->LCD_RAM = 0x13;
    LCD->LCD_RAM = 0x0D; LCD->LCD_RAM = 0x0E; LCD->LCD_RAM = 0x1B;
    LCD->LCD_RAM = 0x71; LCD->LCD_RAM = 0x06; LCD->LCD_RAM = 0x06;
    LCD->LCD_RAM = 0x0A; LCD->LCD_RAM = 0x0F; LCD->LCD_RAM = 0x0E;
    LCD->LCD_RAM = 0x0F; LCD->LCD_RAM = 0x15; LCD->LCD_RAM = 0x0C;
    LCD->LCD_RAM = 0x00;

    LCD->LCD_REG = 0x3A; LCD->LCD_RAM = 0x55;  /* 16bit color */
    LCD->LCD_REG = 0x36; LCD->LCD_RAM = 0x00;

    LCD->LCD_REG = 0x11;
    HAL_Delay(120);
    LCD->LCD_REG = 0x29;
    HAL_Delay(20);
}

/* 设置扫描方向 - 设置0x36寄存器 */
static void lcd_scan_dir(void)
{
    uint16_t regval = 0;
    
    /* 对于ILI9341/ST7789,需要设置BGR位(bit3) */
    if(lcddev.id == 0x9341 || lcddev.id == 0x7789) {
        regval = 0x08;  /* BGR=1 */
    }
    
    /* 设置0x36寄存器 */
    LCD->LCD_REG = 0x36;
    LCD->LCD_RAM = regval;
    
    /* 设置显示区域大小 */
    LCD->LCD_REG = lcddev.setxcmd;
    LCD->LCD_RAM = 0;
    LCD->LCD_RAM = 0;
    LCD->LCD_RAM = (lcddev.width - 1) >> 8;
    LCD->LCD_RAM = (lcddev.width - 1) & 0xFF;
    
    LCD->LCD_REG = lcddev.setycmd;
    LCD->LCD_RAM = 0;
    LCD->LCD_RAM = 0;
    LCD->LCD_RAM = (lcddev.height - 1) >> 8;
    LCD->LCD_RAM = (lcddev.height - 1) & 0xFF;
}

/* 设置窗口 */
static void lcd_set_window(uint16_t sx, uint16_t sy, uint16_t width, uint16_t height)
{
    uint16_t twidth = sx + width - 1;
    uint16_t theight = sy + height - 1;
    
    LCD->LCD_REG = lcddev.setxcmd;
    LCD->LCD_RAM = sx >> 8;
    LCD->LCD_RAM = sx & 0xFF;
    LCD->LCD_RAM = twidth >> 8;
    LCD->LCD_RAM = twidth & 0xFF;
    
    LCD->LCD_REG = lcddev.setycmd;
    LCD->LCD_RAM = sy >> 8;
    LCD->LCD_RAM = sy & 0xFF;
    LCD->LCD_RAM = theight >> 8;
    LCD->LCD_RAM = theight & 0xFF;
}

/**
  * @brief  LCD初始化
  */
void BSP_LCD_Init(void)
{
    GPIO_InitTypeDef gpio_init_struct;
    FSMC_NORSRAM_TimingTypeDef fsmc_read_handle;
    FSMC_NORSRAM_TimingTypeDef fsmc_write_handle;
    
    /* 使能GPIO时钟 */
    __HAL_RCC_GPIOB_CLK_ENABLE();
    
    /* PB15 - 背光 */
    gpio_init_struct.Pin = GPIO_PIN_15;
    gpio_init_struct.Mode = GPIO_MODE_OUTPUT_PP;
    gpio_init_struct.Pull = GPIO_PULLUP;
    gpio_init_struct.Speed = GPIO_SPEED_FREQ_HIGH;
    HAL_GPIO_Init(GPIOB, &gpio_init_struct);
    
    /* FSMC配置 */
    g_sram_handle.Instance = FSMC_NORSRAM_DEVICE;
    g_sram_handle.Extended = FSMC_NORSRAM_EXTENDED_DEVICE;
    g_sram_handle.Init.NSBank = FSMC_NORSRAM_BANK4;
    g_sram_handle.Init.DataAddressMux = FSMC_DATA_ADDRESS_MUX_DISABLE;
    g_sram_handle.Init.MemoryType = FSMC_MEMORY_TYPE_SRAM;
    g_sram_handle.Init.MemoryDataWidth = FSMC_NORSRAM_MEM_BUS_WIDTH_16;
    g_sram_handle.Init.BurstAccessMode = FSMC_BURST_ACCESS_MODE_DISABLE;
    g_sram_handle.Init.WaitSignalPolarity = FSMC_WAIT_SIGNAL_POLARITY_LOW;
    g_sram_handle.Init.WaitSignalActive = FSMC_WAIT_TIMING_BEFORE_WS;
    g_sram_handle.Init.WriteOperation = FSMC_WRITE_OPERATION_ENABLE;
    g_sram_handle.Init.WaitSignal = FSMC_WAIT_SIGNAL_DISABLE;
    g_sram_handle.Init.ExtendedMode = FSMC_EXTENDED_MODE_ENABLE;
    g_sram_handle.Init.AsynchronousWait = FSMC_ASYNCHRONOUS_WAIT_DISABLE;
    g_sram_handle.Init.WriteBurst = FSMC_WRITE_BURST_DISABLE;
    
    /* 读时序 - 使用保守参数 */
    fsmc_read_handle.AddressSetupTime = 0x0F;
    fsmc_read_handle.AddressHoldTime = 0x00;
    fsmc_read_handle.DataSetupTime = 60;
    fsmc_read_handle.BusTurnAroundDuration = 0;
    fsmc_read_handle.CLKDivision = 0;
    fsmc_read_handle.DataLatency = 0;
    fsmc_read_handle.AccessMode = FSMC_ACCESS_MODE_A;
    
    /* 写时序 - 使用保守参数 */
    fsmc_write_handle.AddressSetupTime = 15;
    fsmc_write_handle.AddressHoldTime = 0x00;
    fsmc_write_handle.DataSetupTime = 15;
    fsmc_write_handle.BusTurnAroundDuration = 0;
    fsmc_write_handle.CLKDivision = 0;
    fsmc_write_handle.DataLatency = 0;
    fsmc_write_handle.AccessMode = FSMC_ACCESS_MODE_A;
    
    HAL_SRAM_Init(&g_sram_handle, &fsmc_read_handle, &fsmc_write_handle);
    HAL_Delay(50);
    
    LCD_Debug("\r\n[LCD] Init start...\r\n");
    LCD_Debug("[LCD] LCD_BASE=0x%08lX\r\n", (uint32_t)LCD_BASE);
    
    /* 读取LCD ID */
    uint16_t tmp1, tmp2, tmp3, tmp4;
    LCD->LCD_REG = 0xD3;
    tmp1 = LCD->LCD_RAM;  /* dummy */
    tmp2 = LCD->LCD_RAM;  /* 0x00 */
    tmp3 = LCD->LCD_RAM;  /* 高字节 */
    tmp4 = LCD->LCD_RAM;  /* 低字节 */
    lcddev.id = (tmp3 << 8) | tmp4;
    LCD_Debug("[LCD] 0xD3 read: %04X %04X %04X %04X -> ID=%04X\r\n", tmp1, tmp2, tmp3, tmp4, lcddev.id);
    
    if(lcddev.id != 0x9341) {
        /* 尝试读取ST7789 */
        LCD->LCD_REG = 0x04;
        tmp1 = LCD->LCD_RAM;  /* dummy */
        tmp2 = LCD->LCD_RAM;
        tmp3 = LCD->LCD_RAM;
        tmp4 = LCD->LCD_RAM;
        lcddev.id = (tmp3 << 8) | tmp4;
        LCD_Debug("[LCD] 0x04 read: %04X %04X %04X %04X -> ID=%04X\r\n", tmp1, tmp2, tmp3, tmp4, lcddev.id);
        if(lcddev.id == 0x8552) lcddev.id = 0x7789;
        
        if(lcddev.id != 0x7789) {
            /* 尝试读取NT35310 */
            LCD->LCD_REG = 0xD4;
            tmp1 = LCD->LCD_RAM;  /* dummy */
            tmp2 = LCD->LCD_RAM;
            tmp3 = LCD->LCD_RAM;
            tmp4 = LCD->LCD_RAM;
            lcddev.id = (tmp3 << 8) | tmp4;
            LCD_Debug("[LCD] 0xD4 read: %04X %04X %04X %04X -> ID=%04X\r\n", tmp1, tmp2, tmp3, tmp4, lcddev.id);

            if(lcddev.id != 0x5310) {
                /* 尝试读取ILI9806: 先使能EXTC，再读0xD3 */
                LCD->LCD_REG = 0xFF;
                LCD->LCD_RAM = 0xFF; LCD->LCD_RAM = 0x98; LCD->LCD_RAM = 0x06;
                LCD->LCD_REG = 0xD3;
                tmp1 = LCD->LCD_RAM;  /* dummy */
                tmp2 = LCD->LCD_RAM;
                tmp3 = LCD->LCD_RAM;
                tmp4 = LCD->LCD_RAM;
                lcddev.id = (tmp3 << 8) | tmp4;
                LCD_Debug("[LCD] ILI9806 0xD3 read: %04X %04X %04X %04X -> ID=%04X\r\n", tmp1, tmp2, tmp3, tmp4, lcddev.id);
                /* ILI9806可能返回0x9806或其他值，如果前面都没识别到就当作ILI9806 */
                if(lcddev.id != 0x9806) {
                    LCD_Debug("[LCD] Force to ILI9806\r\n");
                    lcddev.id = 0x9806;
                }
            }
        }
    }
    
    LCD_Debug("[LCD] Final ID=%04X\r\n", lcddev.id);
    
    /* 根据ID执行初始化 */
    if(lcddev.id == 0x7789) {
        LCD_Debug("[LCD] Using ST7789 init\r\n");
        lcd_ex_st7789_reginit();
    } else if(lcddev.id == 0x9341) {
        LCD_Debug("[LCD] Using ILI9341 init\r\n");
        lcd_ex_ili9341_reginit();
    } else if(lcddev.id == 0x5310) {
        LCD_Debug("[LCD] Using NT35310 init\r\n");
        lcd_ex_nt35310_reginit();
    } else if(lcddev.id == 0x9806) {
        LCD_Debug("[LCD] Using ILI9806 init\r\n");
        lcd_ex_ili9806_reginit();
    } else {
        LCD_Debug("[LCD] Unknown ID, using ILI9341 init\r\n");
        lcd_ex_ili9341_reginit();
    }
    
    /* 设置默认参数 */
    lcddev.wramcmd = 0x2C;
    lcddev.setxcmd = 0x2A;
    lcddev.setycmd = 0x2B;
    lcddev.width = 240;
    lcddev.height = 320;
    lcddev.dir = 0;
    
    if(lcddev.id == 0x5310) {
        lcddev.width = 320;
        lcddev.height = 480;
    } else if(lcddev.id == 0x9806) {
        lcddev.width = 480;
        lcddev.height = 800;
    }
    
    LCD_Debug("[LCD] Size: %dx%d\r\n", lcddev.width, lcddev.height);
    
    /* 设置扫描方向 */
    lcd_scan_dir();
    
    /* 开启背光 */
    LCD_BL(1);
    LCD_Debug("[LCD] Backlight ON, clearing screen...\r\n");
    
    /* 清屏 */
    BSP_LCD_Clear(WHITE);
    LCD_Debug("[LCD] Init done!\r\n");
}

/**
  * @brief  清屏
  */
void BSP_LCD_Clear(uint16_t color)
{
    uint32_t i;
    uint32_t total = (uint32_t)lcddev.width * lcddev.height;
    
    lcd_set_window(0, 0, lcddev.width, lcddev.height);
    LCD->LCD_REG = lcddev.wramcmd;
    
    for(i = 0; i < total; i++) {
        LCD->LCD_RAM = color;
    }
}

/**
  * @brief  设置光标位置
  */
void BSP_LCD_SetCursor(uint16_t x, uint16_t y)
{
    LCD->LCD_REG = lcddev.setxcmd;
    LCD->LCD_RAM = x >> 8;
    LCD->LCD_RAM = x & 0xFF;
    LCD->LCD_REG = lcddev.setycmd;
    LCD->LCD_RAM = y >> 8;
    LCD->LCD_RAM = y & 0xFF;
}

/**
  * @brief  画点
  */
void BSP_LCD_DrawPoint(uint16_t x, uint16_t y, uint16_t color)
{
    BSP_LCD_SetCursor(x, y);
    LCD->LCD_REG = lcddev.wramcmd;
    LCD->LCD_RAM = color;
}

/**
  * @brief  填充矩形区域
  */
void BSP_LCD_Fill(uint16_t x1, uint16_t y1, uint16_t x2, uint16_t y2, uint16_t color)
{
    uint32_t i;
    uint16_t width = x2 - x1 + 1;
    uint16_t height = y2 - y1 + 1;
    uint32_t total = (uint32_t)width * height;
    
    lcd_set_window(x1, y1, width, height);
    LCD->LCD_REG = lcddev.wramcmd;
    
    for(i = 0; i < total; i++) {
        LCD->LCD_RAM = color;
    }
}

/**
  * @brief  显示单个字符 (8x16)
  */
void BSP_LCD_ShowChar(uint16_t x, uint16_t y, char c, uint16_t fc, uint16_t bc, uint8_t size)
{
    (void)size;
    uint8_t i, j;
    const uint8_t *font;
    
    if(c < ' ' || c > 'z') c = ' ';
    font = ASCII_8x16[c - ' '];
    
    lcd_set_window(x, y, 8, 16);
    LCD->LCD_REG = lcddev.wramcmd;
    
    for(i = 0; i < 16; i++) {
        for(j = 0; j < 8; j++) {
            if(font[i] & (0x80 >> j)) {
                LCD->LCD_RAM = fc;
            } else {
                LCD->LCD_RAM = bc;
            }
        }
    }
}

/**
  * @brief  显示字符串
  */
void BSP_LCD_ShowString(uint16_t x, uint16_t y, const char *str, uint16_t fc, uint16_t bc, uint8_t size)
{
    while(*str) {
        BSP_LCD_ShowChar(x, y, *str, fc, bc, size);
        x += 8;
        str++;
    }
}

/**
  * @brief  显示数字
  */
void BSP_LCD_ShowNum(uint16_t x, uint16_t y, uint32_t num, uint8_t len, uint16_t fc, uint16_t bc, uint8_t size)
{
    char buf[12];
    uint8_t i;
    
    for(i = 0; i < len; i++) {
        buf[len - 1 - i] = '0' + (num % 10);
        num /= 10;
    }
    buf[len] = '\0';
    
    BSP_LCD_ShowString(x, y, buf, fc, bc, size);
}

/**
  * @brief  格式化输出
  */
void BSP_LCD_Printf(uint16_t x, uint16_t y, uint16_t fc, uint16_t bc, uint8_t size, const char *fmt, ...)
{
    char buf[64];
    va_list args;
    
    va_start(args, fmt);
    vsnprintf(buf, sizeof(buf), fmt, args);
    va_end(args);
    
    BSP_LCD_ShowString(x, y, buf, fc, bc, size);
}
